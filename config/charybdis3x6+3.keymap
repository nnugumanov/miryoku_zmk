// Copyright 2024 Manna Harbour
// https://github.com/manna-harbour/miryoku

#include "../miryoku/custom_config.h"
#include "../miryoku/mapping/42/charybdis3x6+3.h"
#include "../miryoku/miryoku.dtsi"
